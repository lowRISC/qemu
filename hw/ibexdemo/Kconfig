## hw/ibexdemo/Kconfig
```kconfig
# Ibex Demo System

config IBEXDEMO_GPIO
    bool

config IBEXDEMO_SIMCTRL
    bool

config IBEXDEMO_SPI
    bool
    select SSI

config IBEXDEMO_TIMER
    bool

config IBEXDEMO_UART
    bool
```

## hw/jtag/Kconfig
```kconfig
# JTAG devices

config TAP_CTRL
    bool

config TAP_CTRL_RBB
    select TAP_CTRL
    bool
```

## hw/opentitan/Kconfig
```kconfig
# OpenTitan devices

config OT_ADDRESS_SPACE
    bool

config OT_AES
    select OT_KEY_SINK
    select OT_PRNG
    bool

config OT_ALERT
    bool

config OT_AON_TIMER
    bool

config OT_AST_DJ
    select IBEX_CLOCK_SRC
    select OT_RANDOM_SRC
    select OT_CLOCK_CTRL
    bool

config OT_AST_EG
    select IBEX_CLOCK_SRC
    select OT_CLOCK_CTRL
    bool

config OT_CLKMGR
    select IBEX_CLOCK_SRC
    bool

config OT_CLOCK_CTRL
    bool

config OT_COMMON
    bool

config OT_CSRNG
    bool

config OT_DEV_PROXY
    bool

config OT_DM_TL
    select RISCV_DEBUG
    bool

config OT_DMA
    select OT_ADDRESS_SPACE
    bool

config OT_EDN
    bool

config OT_ENTROPY_SRC
    select OT_NOISE_SRC
    bool

config OT_FLASH
    bool

config OT_GPIO_DJ
    bool

config OT_GPIO_EG
    bool

config OT_HMAC
    bool

config OT_I2C
    imply I2C_ECHO
    imply DS1338
    select I2C
    bool

config OT_I2C_HOST_PROXY
    select I2C
    bool

config OT_IBEX_WRAPPER
    select OT_VMAPPER
    bool

config OT_KEY_SINK
    bool

config OT_KEYMGR
    select OT_KEY_SINK
    select OT_LC_CTRL
    select OT_ROM_CTRL
    bool

config OT_KEYMGR_DPE
    select OT_KEY_SINK
    select OT_LC_CTRL
    select OT_ROM_CTRL
    bool

config OT_KMAC
    select OT_KEY_SINK
    bool

config OT_LC_CTRL
    bool

config OT_MBX
    select OT_COMMON
    bool

config OT_NOISE_SRC
    bool

config OT_OTBN
    select OT_KEY_SINK
    select OT_BIGNUMBER
    bool

config OT_OTP
    select OT_OTP_BE_IF

config OT_OTP_BE_IF
    bool

config OT_OTP_DJ
    select OT_OTP
    select OT_PRESENT
    bool

config OT_OTP_EG
    select OT_OTP
    bool

config OT_OTP_OT_BE
    select OT_OTP_BE_IF
    bool

config OT_PINMUX_DJ
    bool

config OT_PINMUX_EG
    bool

config OT_PLIC_EXT
    bool

config OT_PRESENT
    bool

config OT_PRINCE
    bool

config OT_PRNG
    bool

config OT_PWRMGR
    select OT_CLOCK_CTRL
    bool

config OT_RANDOM_SRC
    bool

config OT_ROM_CTRL
    bool
    select OT_COMMON
    select OT_PRINCE

config OT_RSTMGR
    bool

config OT_SENSOR_EG
    bool

config OT_SOC_PROXY
    bool

config OT_SOCDBG_CTRL
    bool

config OT_SPI_DEVICE
    bool

config OT_SPI_HOST
    bool
    select SSI

config OT_SRAM_CTRL
    select OT_PRESENT
    bool

config OT_TIMER
    bool

config OT_UART
    bool

config OT_USBDEV
    bool

config OT_UNIMP
    bool

config OT_VMAPPER
    bool

source otbn/Kconfig
```

## hw/riscv/Kconfig
```kconfig
config RISCV_NUMA
    bool

config IBEX
    bool

config IBEX_COMMON
    bool

# RISC-V machines in alphabetical order

config OT_DARJEELING
    bool
    select IBEX
    select IBEX_COMMON
    select OT_ADDRESS_SPACE
    select OT_AES
    select OT_ALERT
    select OT_AON_TIMER
    select OT_AST_DJ
    select OT_CLKMGR
    select OT_CSRNG
    select OT_DEV_PROXY
    select OT_DM_TL
    select OT_DMA
    select OT_EDN
    select OT_ENTROPY_SRC
    select OT_GPIO_DJ
    select OT_HMAC
    select OT_I2C_DJ
    select OT_IBEX_WRAPPER_DJ
    select OT_KMAC
    select OT_LC_CTRL
    select OT_MBX
    select OT_OTBN
    select OT_OTP_DJ
    select OT_OTP_OT_BE
    select OT_PINMUX_DJ
    select OT_PLIC_EXT
    select OT_PWRMGR
    select OT_RSTMGR
    select OT_ROM_CTRL
    select OT_SENSOR
    select OT_SOC_PROXY
    select OT_SPI_DEVICE
    select OT_SPI_HOST
    select OT_SRAM_CTRL
    select OT_TIMER
    select OT_UART
    select PULP_RV_DM
    select RISCV_DM
    select RISCV_DTM
    select SIFIVE_PLIC
    select SPLIT_IRQ
    select TAP_CTRL_RBB

config OT_EARLGREY
    bool
    select IBEX
    select IBEX_COMMON
    select OT_AES
    select OT_ALERT
    select OT_AON_TIMER
    select OT_AST_EG
    select OT_CLKMGR
    select OT_CSRNG
    select OT_EDN
    select OT_ENTROPY_SRC
    select OT_FLASH
    select OT_GPIO_EG
    select OT_HMAC
    select OT_IBEX_WRAPPER_EG
    select OT_KMAC
    select OT_LC_CTRL
    select OT_OTBN
    select OT_OTP_EG
    select OT_OTP_OT_BE
    select OT_PINMUX_EG
    select OT_PLIC_EXT
    select OT_PWRMGR
    select OT_ROM_CTRL
    select OT_RSTMGR
    select OT_SENSOR
    select OT_SPI_DEVICE
    select OT_SPI_HOST
    select OT_SRAM_CTRL
    select OT_TIMER
    select OT_UART
    select PULP_RV_DM
    select RISCV_DM
    select RISCV_DTM
    select SIFIVE_PLIC
    select TAP_CTRL_RBB

config IBEXDEMO
    bool
    select IBEX
    select IBEX_COMMON
    select IBEXDEMO_GPIO
    select IBEXDEMO_SIMCTRL
    select IBEXDEMO_SPI
    select IBEXDEMO_TIMER
    select IBEXDEMO_UART
    select RISCV_DM
    select RISCV_DTM
    select ST7735
    select TAP_CTRL_RBB
    select UNIMP

config MICROCHIP_PFSOC
    bool
    select CADENCE_SDHCI
    select MCHP_PFSOC_DMC
    select MCHP_PFSOC_IOSCB
    select MCHP_PFSOC_MMUART
    select MCHP_PFSOC_SYSREG
    select RISCV_ACLINT
    select SIFIVE_PDMA
    select SIFIVE_PLIC
    select UNIMP

config OPENTITAN
    bool
    select IBEX
    select IBEX_SPI_HOST
    select IBEX_TIMER
    select IBEX_UART
    select SIFIVE_PLIC
    select UNIMP

config RISCV_VIRT
    bool
    imply PCI_DEVICES
    imply VIRTIO_VGA
    imply TEST_DEVICES
    imply TPM_TIS_SYSBUS
    select RISCV_NUMA
    select GOLDFISH_RTC
    select PCI
    select PCI_EXPRESS_GENERIC_BRIDGE
    select PFLASH_CFI01
    select SERIAL
    select RISCV_ACLINT
    select RISCV_APLIC
    select RISCV_IMSIC
    select SIFIVE_PLIC
    select SIFIVE_TEST
    select SMBIOS
    select VIRTIO_MMIO
    select FW_CFG_DMA
    select PLATFORM_BUS
    select ACPI
    select ACPI_PCI

config RISCV_DEBUG
    bool

config RISCV_DM
    select RISCV_DEBUG
    bool

config RISCV_DTM
    select TAP_CTRL
    bool

config SHAKTI_C
    bool
    select RISCV_ACLINT
    select SHAKTI_UART
    select SIFIVE_PLIC
    select UNIMP

config SIFIVE_E
    bool
    select RISCV_ACLINT
    select SIFIVE_GPIO
    select SIFIVE_PLIC
    select SIFIVE_UART
    select SIFIVE_E_PRCI
    select SIFIVE_E_AON
    select UNIMP

config SIFIVE_U
    bool
    select CADENCE
    select RISCV_ACLINT
    select SIFIVE_GPIO
    select SIFIVE_PDMA
    select SIFIVE_PLIC
    select SIFIVE_SPI
    select SIFIVE_UART
    select SIFIVE_U_OTP
    select SIFIVE_U_PRCI
    select SIFIVE_PWM
    select SSI_M25P80
    select SSI_SD
    select UNIMP

config SPIKE
    bool
    select RISCV_NUMA
    select HTIF
    select RISCV_ACLINT
    select SIFIVE_PLIC
```
